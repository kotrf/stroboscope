## firmware/sdkconfig.defaults
```kconfig
CONFIG_TINYUSB_CDC_ENABLED=y
CONFIG_TINYUSB_DESC_USE_ESPRESSIF_VID=y
CONFIG_TINYUSB_DESC_USE_DEFAULT_PID=y
CONFIG_TINYUSB_DESC_BCD_DEVICE=0x0100
CONFIG_TINYUSB_DESC_MANUFACTURER_STRING="KotRF"
CONFIG_TINYUSB_DESC_PRODUCT_STRING="LED Stroboscope"
CONFIG_TINYUSB_DESC_SERIAL_STRING="123456"
CONFIG_TINYUSB_DESC_CDC_STRING="Espressif CDC Device"
```
